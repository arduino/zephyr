/*
 * Copyright (c) 2026 Microchip Technology Inc.
 *
 * SPDX-License-Identifier: Apache-2.0
 */

#include <microchip/pic32c/pic32ck_sg_gc/common/pic32ck_sg_gc.dtsi>

/ {
	soc {
		can0: can@4501e000 {
			compatible = "microchip,mcan-g1";
			reg = <0x4501e000 0x100>;
			interrupts = <143 0>;
			clocks = <&mclkperiph CLOCK_MCHP_MCLKPERIPH_ID_CAN0_AHB>,
				 <&gclkperiph CLOCK_MCHP_GCLKPERIPH_ID_CAN0>;
			clock-names = "mclk", "gclk";
			bosch,mram-cfg = <0x0 28 8 3 3 0 3 3>;
			status = "disabled";
		};

		can1: can@45020000 {
			compatible = "microchip,mcan-g1";
			reg = <0x45020000 0x100>;
			interrupts = <144 0>;
			clocks = <&mclkperiph CLOCK_MCHP_MCLKPERIPH_ID_CAN1_AHB>,
				 <&gclkperiph CLOCK_MCHP_GCLKPERIPH_ID_CAN1>;
			clock-names = "mclk", "gclk";
			bosch,mram-cfg = <0x0 28 8 3 3 0 3 3>;
			status = "disabled";
		};
	};
};
