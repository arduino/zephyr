## boards/arduino/desire4eu/Kconfig.defconfig
```kconfig
# Copyright 2024 Rahul Arasikere <arasikere.rahul@gmail.com>
# SPDX-License-Identifier: Apache-2.0

if BOARD_DESIRE4EU

source "boards/common/usb/Kconfig.cdc_acm_serial.defconfig"

endif # BT
```

## boards/arduino/desire4eu/Kconfig.desire4eu
```kconfig
# Copyright (c) 2024 STMicroelectronics
# SPDX-License-Identifier: Apache-2.0

config BOARD_DESIRE4EU
	select SOC_STM32C071XX
```

## boards/arduino/desire4eu/board.yml
```yaml
board:
  name: desire4eu
  full_name: Arduino Desire4eu
  vendor: arduino
  socs:
    - name: stm32c071xx
```

## boards/arduino/desire4eu/desire4eu_defconfig
```kconfig
# SPDX-License-Identifier: Apache-2.0

# Serial Drivers
CONFIG_SERIAL=y
CONFIG_UART_INTERRUPT_DRIVEN=y

# Enable console
CONFIG_CONSOLE=y
CONFIG_UART_CONSOLE=y

# GPIO Controller
CONFIG_GPIO=y

CONFIG_USB_DEVICE_PRODUCT="Arduino Desire4eu"
CONFIG_USB_DEVICE_PID=0x0004
CONFIG_USB_DEVICE_INITIALIZE_AT_BOOT=y

CONFIG_UART_LINE_CTRL=y

CONFIG_SHELL=y

CONFIG_USB_CDC_ACM_RINGBUF_SIZE=256
CONFIG_SYSTEM_WORKQUEUE_STACK_SIZE=512
```

## dts/bindings/serial/zephyr,uart-bridge.yaml
```yaml
# Copyright 2025 Google LLC
# SPDX-License-Identifier: Apache-2.0

title: UART bridge

description: |
  Bridges data between two serial devices, for example a USB CDC-ACM serial
  port and an hardware UART.

  The device node must specify exactly two peer phandles for the two serial
  devices to be bridged together. Example configuration:

  uart-bridge {
           compatible = "zephyr,uart-bridge";
           peers = <&cdc_acm_uart0 &uart1>;
           activity-leds = <&tx_led &rx_led>;
  };

include: base.yaml

compatible: "zephyr,uart-bridge"

properties:
  peers:
    type: phandles
    description: Peer device nodes, must contain two phandles
  activity-leds:
    type: phandles
    description: Optional LEDs to indicate activity on the two serial ports, can contain up to two phandles
    required: false
```
