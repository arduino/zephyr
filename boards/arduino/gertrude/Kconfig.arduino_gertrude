## boards/arduino/gertrude/Kconfig.arduino_gertrude
```kconfig
# Copyright (c) 2023 Thomas Stranger
# SPDX-License-Identifier: Apache-2.0

config BOARD_ARDUINO_GERTRUDE
	select SOC_STM32H5F5XX
```

## boards/arduino/gertrude/Kconfig.defconfig
```kconfig
# Arduino Gertrude board configuration

# Copyright (c) 2026 Arduino SRL
# SPDX-License-Identifier: Apache-2.0

if BOARD_ARDUINO_GERTRUDE

configdefault NET_L2_ETHERNET
	default y

endif # BOARD_ARDUINO_GERTRUDE
```

## boards/arduino/gertrude/arduino_gertrude_defconfig
```kconfig
# SPDX-License-Identifier: Apache-2.0

# enable uart driver
CONFIG_SERIAL=y

# console
CONFIG_CONSOLE=y
CONFIG_UART_CONSOLE=y

# enable GPIO
CONFIG_GPIO=y

CONFIG_PWM=y
CONFIG_PWM_CAPTURE=y

CONFIG_USB_DEVICE_STACK_NEXT=y

# Logging configuration
CONFIG_LOG=y
CONFIG_UDC_DRIVER_LOG_LEVEL_WRN=y
CONFIG_USBD_LOG_LEVEL_WRN=y
CONFIG_USBD_GS_USB_LOG_LEVEL_WRN=y
CONFIG_USBD_GS_USB_MAX_CHANNELS=3
CONFIG_USB_DEVICE_GS_USB_COMPATIBILITY_MODE=n
CONFIG_CAN_FD_MODE=y
#CONFIG_CANNECTIVITY_LOG_LEVEL_WRN=y

CONFIG_CDC_ACM_SERIAL_INITIALIZE_AT_BOOT=n
CONFIG_CDC_ACM_SERIAL_PRODUCT_STRING="Arduino Gertrude"
CONFIG_CDC_ACM_SERIAL_MANUFACTURER_STRING="Arduino"
CONFIG_USBD_CDC_ACM_CLASS=y
CONFIG_CDC_ACM_DTE_RATE_CALLBACK_SUPPORT=y
CONFIG_USBD_CDC_ACM_LOG_LEVEL_ERR=y
CONFIG_UDC_DRIVER_LOG_LEVEL_ERR=y
CONFIG_USBD_LOG_LEVEL_ERR=y
CONFIG_UART_LINE_CTRL=y
```

## boards/arduino/gertrude/board.yml
```yaml
board:
  name: arduino_gertrude
  full_name: Arduino Gertrude
  vendor: arduino
  socs:
    - name: stm32h5f5xx
```

## boards/arduino/mezza/Kconfig.defconfig
```kconfig
# Arduino Mezza board configuration

# Copyright (c) 2026 Arduino SRL
# SPDX-License-Identifier: Apache-2.0

if BOARD_ARDUINO_MEZZA

configdefault ETH_DRIVER
	default y if NETWORKING

endif # BOARD_ARDUINO_MEZZA
```

## boards/arduino/mezza/board.yml
```yaml
board:
  name: arduino_mezza
  full_name: Arduino Mezza
  vendor: arduino
  socs:
    - name: stm32h5f5xx
```

## boards/arduino/nano_chandler/Kconfig.arduino_nano_chandler
```kconfig
# Copyright (c) 2026 Arduino SA
# SPDX-License-Identifier: Apache-2.0

config BOARD_ARDUINO_NANO_CHANDLER
	select SOC_PIC32CK1025GC01144
```

## boards/arduino/nano_chandler/board.yml
```yaml
board:
  name: arduino_nano_chandler
  full_name: Arduino Nano Chandler
  vendor: arduino
  socs:
    - name: pic32ck1025gc01144
```

## boards/arduino/nano_esp32/Kconfig.arduino_nano_esp32
```kconfig
# Copyright (c) 2026 ARDUINO SRL
# SPDX-License-Identifier: Apache-2.0

config BOARD_ARDUINO_NANO_ESP32
	select SOC_ESP32S3_WROOM_N16R8
	select SOC_ESP32S3_PROCPU if BOARD_ARDUINO_NANO_ESP32_ESP32S3_PROCPU
	select SOC_ESP32S3_APPCPU if BOARD_ARDUINO_NANO_ESP32_ESP32S3_APPCPU
```

## boards/arduino/nano_esp32/Kconfig.sysbuild
```kconfig
# Copyright (c) 2026 ARDUINO SRL
# SPDX-License-Identifier: Apache-2.0

choice BOOTLOADER
	default BOOTLOADER_MCUBOOT
endchoice

choice BOOT_SIGNATURE_TYPE
	default BOOT_SIGNATURE_TYPE_NONE
endchoice
```

## boards/arduino/nano_esp32/arduino_nano_esp32_appcpu_defconfig
```kconfig
# SPDX-License-Identifier: Apache-2.0

CONFIG_CLOCK_CONTROL=y
CONFIG_ESP_SIMPLE_BOOT=y
CONFIG_BOOTLOADER_MCUBOOT=n
```

## boards/arduino/nano_esp32/arduino_nano_esp32_procpu_defconfig
```kconfig
# SPDX-License-Identifier: Apache-2.0

CONFIG_CONSOLE=y
CONFIG_SERIAL=y
CONFIG_UART_CONSOLE=y
CONFIG_GPIO=y
CONFIG_CLOCK_CONTROL=y
CONFIG_ADC=y
CONFIG_ESP_SPIRAM=y
CONFIG_SPIRAM_MODE_OCT=y
CONFIG_LLEXT_XTENSA_PLT=n
CONFIG_LLEXT_SEPARATE_HEAPS=n
```

## boards/arduino/nano_esp32/board.yml
```yaml
board:
  name: arduino_nano_esp32
  full_name: arduino_nano_esp32
  vendor: arduino
  socs:
  - name: esp32s3
```

## boards/arduino/nano_xl_link/Kconfig.arduino_nano_xl_link
```kconfig
# Copyright (c) 2026 Arduino SA
# SPDX-License-Identifier: Apache-2.0

config BOARD_ARDUINO_NANO_XL_LINK
	select SOC_PIC32CK1025GC01144
```

## boards/arduino/nano_xl_link/Kconfig.defconfig
```kconfig
# Copyright (c) 2026 Arduino SA
# SPDX-License-Identifier: Apache-2.0

if BOARD_ARDUINO_NANO_XL_LINK

source "boards/common/usb/Kconfig.cdc_acm_serial.defconfig"

config USE_DT_CODE_PARTITION
	default y

endif # BOARD_ARDUINO_NANO_XL_LINK
```

## boards/arduino/nano_xl_link/board.yml
```yaml
board:
  name: arduino_nano_xl_link
  full_name: Arduino Nano XL Link
  vendor: arduino
  socs:
    - name: pic32ck2051sg01144
```

## boards/arduino/ventuno_q/Kconfig.arduino_ventuno_q
```kconfig
# Copyright (c) 2026 Arduino SA
# SPDX-License-Identifier: Apache-2.0

config BOARD_ARDUINO_VENTUNO_Q
	select SOC_STM32H5F5XX
```

## boards/arduino/ventuno_q/board.yml
```yaml
board:
  name: arduino_ventuno_q
  full_name: Arduino Ventuno Q
  vendor: arduino
  socs:
    - name: stm32h5f5xx
```

## boards/shields/arduino_nano_xl_link_connector/Kconfig.shield
```kconfig
# Copyright (c) 2026 Arduino SA
# SPDX-License-Identifier: Apache-2.0

config SHIELD_ARDUINO_NANO_XL_LINK_CONNECTOR
	def_bool $(shields_list_contains,arduino_nano_xl_link_connector)
```

## boards/shields/nano_xl_link_monica/Kconfig.defconfig
```kconfig
# Copyright (c) 2026 Arduino SA
# SPDX-License-Identifier: Apache-2.0

if SHIELD_NANO_XL_LINK_MONICA

if NETWORKING

choice WIFI_ESP_AT_VERSION
	default WIFI_ESP_AT_VERSION_1_7
	depends on WIFI_ESP_AT
endchoice

endif # NETWORKING

endif # SHIELD_NANO_XL_LINK_MONICA
```

## boards/shields/nano_xl_link_monica/Kconfig.shield
```kconfig
# Copyright (c) 2026 Arduino SA
# SPDX-License-Identifier: Apache-2.0

config SHIELD_NANO_XL_LINK_MONICA
	def_bool $(shields_list_contains,nano_xl_link_monica)
```

## drivers/can/Kconfig.mchp
```kconfig
# Microchip M_CAN CAN configuration options
# Copyright (c) 2026 Microchip Technology Inc.
# SPDX-License-Identifier: Apache-2.0

config CAN_MCHP_MCAN_G1
	bool "Microchip M_CAN G1 CAN driver"
	default y
	depends on DT_HAS_MICROCHIP_MCAN_G1_ENABLED
	select CAN_MCAN
	help
	  Enable CAN support for Microchip MCUs using the Bosch M_CAN IP core.
	  This driver supports:
	    - PIC32CK SG/GC series
```
