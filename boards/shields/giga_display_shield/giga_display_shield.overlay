/*
 * Copyright (c) 2024 Arduino SA
 *
 * SPDX-License-Identifier: Apache-2.0
 */

&zephyr_mipi_dsi {
	st7701: st7701@0 {
		status = "okay";
		compatible = "sitronix,st7701";
		reg = <0x0>;
		height = <800>;
		width = <480>;
		data-lanes = <2>;
		pixel-format = <MIPI_DSI_PIXFMT_RGB565>;
		rotation = <0>;
	};
};
