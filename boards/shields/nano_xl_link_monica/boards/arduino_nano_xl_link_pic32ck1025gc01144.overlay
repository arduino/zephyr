/*
 * Copyright (c) 2026 Arduino SA
 *
 * SPDX-License-Identifier: Apache-2.0
 */

#include <zephyr/dt-bindings/gpio/gpio.h>

/*
 * ESP8266 WiFi module on UART1 (sercom1). D7 (&portd 11) is the module's
 * RESET/CH_PD line.
 *
 * The Monica carrier has no Zephyr board variant of its own: it is the plain
 * arduino_nano_xl_link board plus this shield, so this file is named after
 * the bare board target. Only additions belong here - shield overlays are
 * applied *before* the core's DTC_OVERLAY_FILE and so cannot override it; the
 * carrier's overrides live in the core's monica.overlay, passed as
 * EXTRA_DTC_OVERLAY_FILE.
 */
&sercom1 {
	esp8266: esp8266 {
		compatible = "espressif,esp-at";
		reset-gpios = <&portd 11 GPIO_ACTIVE_LOW>;
	};
};
