## boards/realtek/rtl872xd_evb/rtl872xd_evb_defconfig
```kconfig
# Copyright (c) 2024 Realtek Semiconductor Corp.
# SPDX-License-Identifier: Apache-2.0

CONFIG_RUNTIME_NMI=y

CONFIG_CORTEX_M_SYSTICK=y

# Enable hardware stack protection
CONFIG_HW_STACK_PROTECTION=y

# This board implies building Non-Secure firmware
CONFIG_TRUSTED_EXECUTION_NONSECURE=y

# enable rcc
CONFIG_CLOCK_CONTROL=y

# enable uart
CONFIG_SERIAL=y

# console
CONFIG_CONSOLE=y
CONFIG_UART_CONSOLE=y

# enable stdout and printk
CONFIG_STDOUT_CONSOLE=y
CONFIG_PRINTK=y
CONFIG_CONSOLE_HANDLER=y
CONFIG_CONSOLE_SUBSYS=y

# CONFIG_HWINFO=y
# CONFIG_HWINFO_SHELL=y
CONFIG_SHELL=y
CONFIG_LOG=y

# enable prng
CONFIG_ENTROPY_GENERATOR=y
CONFIG_DMA=y
CONFIG_FLASH=y
## CONFIG_SPI=y
CONFIG_I2C=y
CONFIG_WATCHDOG=y

# # CONFIG_GPIO=y
CONFIG_RTC=y
CONFIG_ADC=y
# CONFIG_LED_STRIP=y
CONFIG_COUNTER=y
CONFIG_PWM=y
CONFIG_PWM_CAPTURE=y
# CONFIG_CRYPTO=y


# enable wifi
CONFIG_WIFI=y
CONFIG_NET_L2_ETHERNET=y
CONFIG_NET_UDP_CHECKSUM=y
CONFIG_REALTEK_AMEBA_HAL_LIB=y
CONFIG_REALTEK_AMEBA_ZEPHYR_WIFI=y
CONFIG_WLAN=y
CONFIG_REALTEK_AMEBA_WIFI_INIC=n
CONFIG_ETH_DRIVER=y
CONFIG_ETH_PHY_DRIVER=y
CONFIG_NET_DHCPV4=y
CONFIG_WIFI_AMEBA=y
CONFIG_NETWORKING=y
##set CONFIG_NEWLIB_LIBC=y when CONFIG_NET_L2_WIFI_SHELL is enabled
CONFIG_NEWLIB_LIBC=y
CONFIG_NET_L2_WIFI_SHELL=y
CONFIG_NEWLIB_LIBC=y
CONFIG_NET_L2_WIFI_MGMT=y
CONFIG_NET_IPV4=y
CONFIG_NET_SHELL=y
CONFIG_NET_UDP=y
CONFIG_NET_MGMT=y
CONFIG_NET_DHCPV4_SERVER=y
CONFIG_NET_IF_MAX_IPV4_COUNT=2
CONFIG_NET_TCP=y
CONFIG_NET_IF_MAX_IPV6_COUNT=2
CONFIG_NET_LOG=y

# zperf todo
# CONFIG_NET_ZPERF=y
# CONFIG_NET_SOCKETS=y
# CONFIG_NET_SOCKETS_SERVICE_THREAD_PRIO=-1
# CONFIG_NET_SOCKETS_POLL_MAX=12
# # CONFIG_POSIX_API=y
# CONFIG_NET_CONFIG_SETTINGS=y
# CONFIG_NET_CONFIG_MY_IPV4_ADDR="192.168.45.100"
# CONFIG_NET_CONFIG_PEER_IPV4_ADDR="192.168.45.1"

# for zperf tp
# CONFIG_NET_PKT_RX_COUNT=40
# CONFIG_NET_PKT_TX_COUNT=40
# CONFIG_NET_BUF_RX_COUNT=160
# CONFIG_NET_BUF_TX_COUNT=160
# CONFIG_NET_BUF_DATA_SIZE=256

# TODO
CONFIG_DYNAMIC_INTERRUPTS=y
CONFIG_NOCACHE_MEMORY=y
```

## boards/realtek/rtl872xda_evb/rtl872xda_evb_defconfig
```kconfig
# Copyright (c) 2024 Realtek Semiconductor Corp.
# SPDX-License-Identifier: Apache-2.0

CONFIG_RUNTIME_NMI=y

CONFIG_CORTEX_M_SYSTICK=y

# Enable hardware stack protection
CONFIG_HW_STACK_PROTECTION=y

# enable rcc
CONFIG_CLOCK_CONTROL=y

# enable uart
CONFIG_SERIAL=y

# console
CONFIG_CONSOLE=y
CONFIG_UART_CONSOLE=y

# enable stdout and printk
CONFIG_STDOUT_CONSOLE=y
CONFIG_PRINTK=y
CONFIG_CONSOLE_HANDLER=y
CONFIG_CONSOLE_SUBSYS=y

CONFIG_HWINFO=y
CONFIG_HWINFO_SHELL=y
CONFIG_SHELL=y
CONFIG_LOG=y

# enable trng
CONFIG_ENTROPY_GENERATOR=y
CONFIG_DMA=y
CONFIG_FLASH=y
# CONFIG_SPI=y
CONFIG_I2C=y
CONFIG_WATCHDOG=y

# CONFIG_GPIO=y
CONFIG_RTC=y
CONFIG_ADC=y
CONFIG_LED_STRIP=y
CONFIG_COUNTER=y
CONFIG_PWM=y
CONFIG_PWM_CAPTURE=y
CONFIG_I2S=y
CONFIG_AUDIO=y
CONFIG_AUDIO_DMIC=y
# CONFIG_CRYPTO=y

# enable captouch
CONFIG_INPUT=y

# enable wifi
CONFIG_WIFI=y
CONFIG_NET_L2_ETHERNET=y
CONFIG_NET_IPV6=y
CONFIG_NET_UDP_CHECKSUM=y
CONFIG_REALTEK_AMEBA_HAL_LIB=y
CONFIG_REALTEK_AMEBA_ZEPHYR_WIFI=y
CONFIG_WLAN=y
CONFIG_REALTEK_AMEBA_WIFI_INIC=y
CONFIG_ETH_DRIVER=y
CONFIG_ETH_PHY_DRIVER=y
CONFIG_NET_DHCPV4=y
CONFIG_WIFI_AMEBA=y
CONFIG_NETWORKING=y
CONFIG_NET_L2_WIFI_SHELL=y
CONFIG_NET_L2_WIFI_MGMT=y
CONFIG_NET_IPV4=y
CONFIG_NET_SHELL=y
CONFIG_NET_UDP=y
CONFIG_NET_MGMT=y
CONFIG_NET_DHCPV4_SERVER=y
CONFIG_NET_IF_MAX_IPV4_COUNT=2
#set CONFIG_NEWLIB_LIBC=y when CONFIG_NET_L2_WIFI_SHELL is enabled
CONFIG_NEWLIB_LIBC=y
CONFIG_NET_LOG=y
#zperf todo
#tcp
#CONFIG_NET_TCP=y

#TODO
CONFIG_DYNAMIC_INTERRUPTS=y
CONFIG_NOCACHE_MEMORY=y
```

## boards/shields/giga_display_shield/boards/arduino_giga_r1_m7.conf
```kconfig
# Copyright (c) 2023 bytes at work AG
# SPDX-License-Identifier: Apache-2.0

CONFIG_MEMC=y
CONFIG_STM32_LTDC_RGB565=y
CONFIG_HEAP_MEM_POOL_SIZE=65536
CONFIG_DISPLAY_ST7701_INIT_PRIORITY=87
CONFIG_STM32_LTDC_DISABLE_FMC_BANK1=y
CONFIG_LV_Z_POINTER_INPUT=y
CONFIG_INPUT_GT911_INTERRUPT=y
```

## drivers/audio/Kconfig.ameba_dmic
```kconfig
# Copyright (c) 2024 Realtek Semiconductor Corp.
# SPDX-License-Identifier: Apache-2.0

config AUDIO_AMEBA_DMIC
	bool "Ameba Digital PDM microphone attached to I2S support"
	default y
	depends on DT_HAS_REALTEK_AMEBA_CODEC_ENABLED
	select I2S
	select PINCTRL
	# select HAS_STLIB
	help
	  Enable Ameba microphone support on the selected board
```

## drivers/crypto/Kconfig.ameba
```kconfig
# AMEBA Cryptographic Accelerator configuration options

# Copyright (c) 2024 Realtek Semiconductor Corp.
# SPDX-License-Identifier: Apache-2.0

config CRYPTO_AMEBA
	bool "AMEBA Cryptographic Accelerator driver"
	default y
	depends on DT_HAS_REALTEK_AMEBA_CRYPTO_ENABLED
	help
	  Enable AMEBA HAL-based Cryptographic Accelerator driver.
```

## drivers/dma/Kconfig.ameba
```kconfig
# Copyright (c) 2024 Realtek Semiconductor Corp.
# SPDX-License-Identifier: Apache-2.0

config DMA_AMEBA
	bool "AMEBA General Purpose DMA driver"
	depends on DT_HAS_REALTEK_AMEBA_GDMA_ENABLED
	default y
	help
	  General Purpose DMA for AMEBA series.

if DMA_AMEBA

config DMA_AMEBA_LLI
	bool "AMEBA Linked List Mode"
	default n
	help
	  This option supports data block in the form of linked lists.

endif # DMA_AMEBA
```

## drivers/flash/Kconfig.ameba
```kconfig
# Copyright (c) 2024 Realtek Semiconductor Corp.
# SPDX-License-Identifier: Apache-2.0

config SOC_FLASH_AMEBA
	bool "AMEBA flash driver"
	default y
	depends on DT_HAS_REALTEK_AMEBA_FLASH_CONTROLLER_ENABLED
	select FLASH_HAS_DRIVER_ENABLED
	select FLASH_HAS_PAGE_LAYOUT
	select FLASH_HAS_EXPLICIT_ERASE
	help
	  Enable AMEBA internal flash driver.
```

## drivers/spi/Kconfig.ameba
```kconfig
# AMEBA SPI configuration

# Copyright (c) 2024 Realtek Semiconductor Corp.
# SPDX-License-Identifier: Apache-2.0

menuconfig SPI_AMEBA
	bool "AMEBA SPI driver"
	default y
	depends on DT_HAS_REALTEK_AMEBA_SPI_ENABLED
	select PINCTRL
	help
		Enables support for AMEBA SPI driver.

if SPI_AMEBA

config SPI_AMEBA_INTERRUPT
	bool "AMEBA SPI interrupt mode"
	help
		Enables interrupt support for AMEBA SPI driver.

config SPI_AMEBA_DMA
	bool "AMEBA SPI DMA Support"
	select DMA
	select CACHE_MANAGEMENT if CPU_HAS_DCACHE
	help
	  Enable the SPI DMA mode.

endif # SPI_AMEBA
```

## drivers/usb/udc/Kconfig.ameba
```kconfig
# AMEBA USB Device controller Driver Configuration

# Copyright (c) 2024 Realtek Semiconductor Corp.
# SPDX-License-Identifier: Apache-2.0

config UDC_AMEBA
	bool "Ameba USB device controller driver"
	depends on DT_HAS_REALTEK_AMEBA_UDC_ENABLED
	select REALTEK_AMEBA_ZEPHYR_UDC
	select REALTEK_AMEBA_USB_DEVICE
	default y
	help
	  Ameba USB device controller driver.
```

## drivers/wifi/ameba/Kconfig.ameba
```kconfig
# Copyright (c) 2024 Realtek Semiconductor Corp.
# SPDX-License-Identifier: Apache-2.0

menuconfig WIFI_AMEBA
	bool "AMEBA SoC WiFi support"
	default y
	select WIFI_USE_NATIVE_NETWORKING
	select ZEPHYR_WIFI
	#select NET_L2_WIFI_MGMT

config ZEPHYR_WIFI
	bool

if WIFI_AMEBA

	config NET_TCP_WORKQ_STACK_SIZE
		default 2048

	config NET_RX_STACK_SIZE
		default 2048

	config NET_MGMT_EVENT_STACK_SIZE
		default 2048

	config RTK_WIFI_STA_AUTO_DHCPV4
		bool "Automatically starts DHCP4 negotiation"
		depends on NET_DHCPV4
		depends on NET_IPV4
		help
			WiFi driver will automatically initiate DHCPV4 negotiation when connected.

endif
```

## dts/bindings/audio/realtek,ameba-codec.yaml
```yaml
# Copyright (c) 2024 Realtek Semiconductor Corp.
# SPDX-License-Identifier: Apache-2.0

description: AMEBA digital PDM microphone family

compatible: "realtek,ameba-codec"

include: [base.yaml, pinctrl-device.yaml]
# include: i2s-device.yaml

properties:
  reg:
    required: true

  clocks:
    required: true

  pinctrl-0:
    required: true

  pinctrl-names:
    required: true

  i2s-index:
    type: int
    description: the index of I2S connect
```

## dts/bindings/crypto/realtek,ameba-crypto.yaml
```yaml
# Copyright (c) 2024 Realtek Semiconductor Corp.
# SPDX-License-Identifier: Apache-2.0

description: AMEBA Cryptographic Accelerator

compatible: "realtek,ameba-crypto"

include: base.yaml

properties:
  reg:
    required: true

  clocks:
    required: true
```

## dts/bindings/flash_controller/realtek,ameba-flash-controller.yaml
```yaml
description: AMEBA Family flash controller

compatible: "realtek,ameba-flash-controller"

include: flash-controller.yaml
```

## dts/bindings/i2s/realtek,ameba-i2s.yaml
```yaml
# Copyright (c) 2024 Realtek Semiconductor Corp.
# SPDX-License-Identifier: Apache-2.0

description: AMEBA I2S controller

compatible: "realtek,ameba-i2s"

include: [i2s-controller.yaml, pinctrl-device.yaml]

properties:
  reg:
    required: true

  interrupts:
    required: true

  dmas:
    required: true

  dma-names:
    required: true

  pinctrl-0:
    required: true

  pinctrl-names:
    required: true

  index:
    type: int
    description: Represent the different i2s interfaces.
    enum:
      - 0 # i2s0
      - 1 # i2s1

  mclk-multiple:
    type: int
    description: The multiple relationship between CPU clock and mclk, we often use 128 and 256.
    enum:
      - 64
      - 128
      - 256

  mclk-fixed-max:
    type: int
    description: Whether to use the max fixed mclk.
    enum:
      - 20000000
      - 0

  tdmmode:
    type: int
    description: channel number in I2S tdm mode.
    enum:
      - 0 # 2channel
      - 1 # 4channel
      - 2 # 6channel
      - 3 # 8channel

  fifo-num:
    type: int
    description: I2S fifo number
    enum:
      - 0 # 2channel
      - 1 # 4channel
      - 2 # 6channel
      - 3 # 8channel

  multiio:
    type: int
    description: Whether to use I2S multi-io mode.
    enum:
      - 0
      - 1

  chn-len:
    type: int
    description: Select channel length.
    enum:
      - 0 # 16bit
      - 1 # 20bit
      - 2 # 24bit
      - 4 # 32bit

  mono-stereo:
    type: int
    description: Whether to use I2S mono mode.
    enum:
      - 0
      - 1

  clock-mode:
    type: int
    description: Select SPORT clock, use XTAL40M or I2S PLL
    enum:
      - 40000000
      - 98304000
      - 45158400

  pll-tune:
    type: int
    description: PLL clock tune.
    enum:
      - 0 # auto
      - 1 # faster
      - 2 # slower
```

## dts/bindings/rtc/realtek,ameba-rtc.yaml
```yaml
# Copyright (c) 2024 Realtek Semiconductor Corp.
# SPDX-License-Identifier: Apache-2.0

description: AMEBA RTC

compatible: "realtek,ameba-rtc"

include: [rtc.yaml, rtc-device.yaml]

properties:
  reg:
    required: true
  alarms-count:
    enum:
      - 0
      - 1
```

## dts/bindings/usb/realtek,ameba-udc.yaml
```yaml
# Copyright (c) 2024 Realtek Semiconductor Corp.
# SPDX-License-Identifier: Apache-2.0

description: Realtek Ameba USB Device controller

compatible: "realtek,ameba-udc"

include: [base.yaml]

bus: usb

properties:
  reg:
    required: true

  interrupts:
    required: true

  in-ep-cnt:
    type: int
    required: true

  out-ep-cnt:
    type: int
    required: true

  udc-max-speed:
    type: int
    required: true

  ep-ranges:
    type: array
    required: true
```

## dts/bindings/usb/realtek,ameba-usb.yaml
```yaml
# Copyright (c) 2024 Realtek Semiconductor Corp.
# SPDX-License-Identifier: Apache-2.0

description: Realtek Ameba USB OTG controller

compatible: "realtek,ameba-usb"

include: [base.yaml]

bus: usb

properties:
  reg:
    required: true

  interrupts:
    required: true
```

## dts/bindings/watchdog/realtek,ameba-watchdog.yaml
```yaml
# Copyright (c) 2024 Realtek Semiconductor Corp.
# SPDX-License-Identifier: Apache-2.0

description: Ameba watchdog

compatible: "realtek,ameba-watchdog"

include: base.yaml

properties:
  reg:
    required: true

  early_int_cnt:
    type: int
    default: 500
    description: |
      WDG parameter specifies WDG early interrupt trigger threshold.
      This parameter must be set to a value in the 1-65535 range
```

## soc/realtek/ameba/amebad/Kconfig.defconfig
```kconfig
# Copyright (c) 2024 Realtek Semiconductor Corp.
# SPDX-License-Identifier: Apache-2.0

if SOC_SERIES_AMEBAD

rsource "Kconfig.defconfig.amebad"

config SYS_CLOCK_HW_CYCLES_PER_SEC
	default $(dt_node_int_prop_int,/clocks/clk_sys,clock-frequency)

config CACHE_MANAGEMENT
	default y

endif #SOC_SERIES_AMEBAD
```

## soc/realtek/ameba/amebad/Kconfig.defconfig.amebad
```kconfig
# Copyright (c) 2024 Realtek Semiconductor Corp.
# SPDX-License-Identifier: Apache-2.0

if SOC_AMEBAD

config NUM_IRQS
	default 64

# This option for code in modules/hal
config AMEBAD
	bool
	default y

endif # SOC_AMEBAD
```

## soc/realtek/ameba/amebad/Kconfig.soc
```kconfig
# Copyright (c) 2024 Realtek Semiconductor Corp.
# SPDX-License-Identifier: Apache-2.0

config SOC_SERIES_AMEBAD
	bool
	select SOC_FAMILY_REALTEK_AMEBA

config SOC_SERIES
	default "amebad" if SOC_SERIES_AMEBAD

config SOC_AMEBAD
	bool
	select SOC_SERIES_AMEBAD

config SOC
	default "amebad" if SOC_AMEBAD

config ARM_CORE_CM4
	bool
	default y if SOC_AMEBAD
```

## soc/realtek/ameba/amebadplus/Kconfig.defconfig.amebadplus
```kconfig
# Copyright (c) 2024 Realtek Semiconductor Corp.
# SPDX-License-Identifier: Apache-2.0

if SOC_AMEBADPLUS

config NUM_IRQS
	default 96

# This option for code in modules/hal
config AMEBADPLUS
	bool
	default y

endif # SOC_AMEBADPLUS
```

## soc/realtek/ameba/amebadplus/Kconfig.soc
```kconfig
# Copyright (c) 2024 Realtek Semiconductor Corp.
# SPDX-License-Identifier: Apache-2.0

config SOC_SERIES_AMEBADPLUS
	bool
	select SOC_FAMILY_REALTEK_AMEBA

config SOC_SERIES
	default "amebadplus" if SOC_SERIES_AMEBADPLUS

config SOC_AMEBADPLUS
	bool
	select SOC_SERIES_AMEBADPLUS

config SOC
	default "amebadplus" if SOC_AMEBADPLUS

config ARM_CORE_CM4
	bool
	default y if SOC_AMEBADPLUS
```
