## drivers/crypto/Kconfig.se05x
```kconfig
config CRYPTO_SE05X
	bool "NXP SE05X support"
	default y
	depends on PLUGANDTRUST
	depends on DT_HAS_NXP_SE05X_ENABLED
	select I2C
	help
	  Enable NXP SE05X secure element support support
```

## drivers/usb/udc/Kconfig.mchp
```kconfig
# Copyright(c) 2026 Microchip Technology Inc.
# SPDX-License-Identifier: Apache-2.0

config UDC_MCHP_G1
	bool
	default y
	depends on DT_HAS_MICROCHIP_USB_G1_ENABLED
	select PINCTRL
	select SYS_MEM_BLOCKS
	select EVENTS
	help
	  USB Device Controller Driver for USB G1 group of IPs.

if UDC_MCHP_G1

config UDC_MCHP_G1_STACK_SIZE
	int "UDC controller driver internal thread stack size"
	default 512
	help
	  Device controller driver internal thread stack size.

config UDC_MCHP_G1_THREAD_PRIORITY
	int "UDC controller driver thread priority"
	default 8
	help
	  Device controller driver thread priority.

endif # UDC_MCHP_G1

config UDC_MCHP_G2
	bool "Microchip G2 USB device controller driver"
	default y
	depends on DT_HAS_MICROCHIP_USB_G2_ENABLED
	select UDC_DRIVER_HAS_HIGH_SPEED_SUPPORT
	select EVENTS
	help
	  USB device controller driver for Microchip G2 family.
	  This driver supports USB 2.0 High-Speed and Full-Speed operation.

if UDC_MCHP_G2

config UDC_MCHP_G2_STACK_SIZE
	int "UDC controller driver internal thread stack size"
	depends on UDC_MCHP_G2
	default 1024
	help
	  Microchip G2 USB device controller driver internal thread stack size.

config UDC_MCHP_G2_THREAD_PRIORITY
	int "Microchip G2 controller driver thread priority"
	depends on UDC_MCHP_G2
	default 8
	help
	  Microchip G2 USB device controller driver thread priority.

config UDC_MCHP_G2_VBUS_POLL_PERIOD_MS
	int "VBUS polling period in milliseconds"
	depends on UDC_MCHP_G2
	default 100
	range 10 1000
	help
	  Period between successive VBUS level checks performed by the system
	  work queue.  A shorter period reduces the latency between cable
	  plug/unplug and the UDC_EVT_VBUS_READY / UDC_EVT_VBUS_REMOVED event
	  being delivered to the upper layer, at the cost of slightly higher
	  CPU overhead.  100 ms is adequate for typical USB-device applications.

endif # UDC_MCHP_G2
```

## drivers/usb/udc/Kconfig.sam_uotghs
```kconfig
# Copyright (c) 2026 Gerson Fernando Budke <nandojve@gmail.com>
# SPDX-License-Identifier: Apache-2.0

DT_SAM_HAS_HIGH_SPEED := $(dt_compat_any_has_prop,$(DT_COMPAT_ATMEL_SAM_UOTGHS),maximum-speed,high-speed)

config UDC_SAM_UOTGHS
	bool "SAM UOTGHS USB Device Controller driver"
	default y
	depends on DT_HAS_ATMEL_SAM_UOTGHS_ENABLED
	select PINCTRL
	select EVENTS
	select UDC_DRIVER_HAS_HIGH_SPEED_SUPPORT if $(DT_SAM_HAS_HIGH_SPEED)
	help
	  SAM3X/SAM3A family UOTGHS device controller driver.

	  The driver support High-Speed (480 Mbps) and Full-Speed (12 Mbps)
	  operation.

if UDC_SAM_UOTGHS

config UDC_SAM_UOTGHS_STACK_SIZE
	int "UDC controller driver internal thread stack size"
	default 512
	help
	  Device controller driver internal thread stack size.

config UDC_SAM_UOTGHS_THREAD_PRIORITY
	int "UDC controller driver thread priority"
	default 8
	help
	  Device controller driver thread priority.

endif # UDC_SAM_UOTGHS
```

## dts/bindings/adc/microchip,adc-g2.yaml
```yaml
# Copyright (c) 2026 Microchip Technology Inc.
# SPDX-License-Identifier: Apache-2.0

title: Microchip ADC G2 Driver

description: |
  Binding for the Microchip ADC driver supporting Group G2 peripherals.

  Group G2 ADC driver supports the following hardware peripheral:
    - module name="ADC" id="03620" version="1b0"

compatible: "microchip,adc-g2"

include:
  - name: adc-controller.yaml
  - name: pinctrl-device.yaml

properties:
  reg:
    required: true
    description: |
      Register base address and size for the ADC peripheral.

  interrupts:
    required: true
    description: |
      Interrupt specifier for the ADC peripheral.

  clocks:
    required: true
    description: |
      Clock phandles used to drive the ADC.

  clock-names:
    required: true
    description: |
      Clock name corresponding to the `clocks` entry.

  ctrl-clock-div:
    type: int
    required: true
    description: |
      This field(CTLCKDIV) divides the GCLK_ADC input clock into ADC control clock(CTL_CLK).

      Range from 0 to 63.

  adc-div-ratio:
    type: int
    required: true
    description: |
      Division Ratio for ADC Sampling Clock.

      This field(ADCDIV) provides the ADC analog functional clock referred to as the ADC clock or
      TAD, (i.e., the period of the ADC clock). It divides CTL_CLK output clock from
      (GCLK_ADC Period * (CTLCKDIV + 1)) with period = TQ to produce the resulting ADC_CLK
      for ADC sampling and converting. It will have the period TAD given by the
      formula: TAD = (GCLK_ADC x Period * (CTLCKDIV + 1)) * (2 * ADCDIV)
      Range from 1 to 127.

  adc-wkup-clock-count:
    type: int
    required: true
    description: |
      Wake-Up TAD Clock Count.

      This field represent the number of ADC TAD clocks required to warm-up the ADC module before
      it can perform conversion.

  num-channels:
    type: int
    required: true
    description: |
      Number of input channels supported by this ADC instance.

io-channel-cells:
  - input
```

## dts/bindings/can/microchip,mcan-g1.yaml
```yaml
# Copyright (c) 2026 Microchip Technology Inc.
# SPDX-License-Identifier: Apache-2.0
title: Microchip M_CAN FD Controller (Group 1)

description: |
  Microchip M_CAN CAN FD controller

  Unified binding for all Microchip MCUs using the Bosch M_CAN IP core
  (ISO 11898-1:2015, CAN 2.0 part A/B, CAN FD).

  Supported families:
    - PIC32CK SG/GC series

compatible: "microchip,mcan-g1"

include:
  - name: bosch,m_can-base.yaml
  - name: pinctrl-device.yaml

properties:
  reg:
    required: true

  interrupts:
    required: true

  clocks:
    required: true
    description: |
      Phandles to the clock controllers. Must provide two clocks:
        1. MCLK (AHB bus clock) - required for bus access
        2. GCLK (peripheral clock) - core clock for CAN timing

  clock-names:
    required: true
    description: |
      Clock names for the CAN peripheral. Must include:
        - "mclk" for the AHB bus clock (MCLK peripheral)
        - "gclk" for the peripheral clock (GCLK peripheral)

examples:
  - |
    can0: can@deadbeef {
        compatible = "microchip,mcan-g1";
        reg = <0xdeadbeef 0x100>;
        interrupts = <143 0>;
        clocks = <&mclkperiph CLOCK_MCHP_MCLKPERIPH_ID_CAN0_AHB>,
                 <&gclkperiph CLOCK_MCHP_GCLKPERIPH_ID_CAN0>;
        clock-names = "mclk", "gclk";
        bosch,mram-cfg = <0x0 28 8 3 3 0 3 3>;
        pinctrl-0 = <&can0_default>;
        pinctrl-names = "default";
        status = "disabled";
    };
```

## dts/bindings/crypto/nxp,se05x.yaml
```yaml
# Copyright (c) 2026 ARDUINO SRL
# SPDX-License-Identifier: Apache-2.0

description: "NXP Crypto SE05X"

compatible: "nxp,se05x"

include: base.yaml

properties:
  reg:
    required: true

  se05x,en-gpios:
    type: phandle-array
    description: Enable gpio
```

## dts/bindings/ethernet/mdio/microchip,gmac-g1-mdio.yaml
```yaml
# Copyright (c) 2026 Microchip Technology Inc.
# SPDX-License-Identifier: Apache-2.0

description: |
  Microchip GMAC MDIO binding

  Group G1 MDIO driver supports following hardware peripherals:
    - module name="GMAC" id="U2005" version="1.0.0"

compatible: "microchip,gmac-g1-mdio"

include:
  - name: mdio-controller.yaml
  - name: pinctrl-device.yaml

examples:
  - |
    &mdio {
      compatible = "microchip,gmac-g1-mdio";
      clocks = <&mclkperiph CLOCK_MCHP_MCLKPERIPH_ID_AHB_GMAC>,
        <&mclkperiph CLOCK_MCHP_MCLKPERIPH_ID_APBC_GMAC>;
    };

properties:
  clocks:
    type: phandle-array
```

## dts/bindings/ethernet/microchip,gmac-g1-eth.yaml
```yaml
# Copyright (c) 2026 Microchip Technology Inc.
# SPDX-License-Identifier: Apache-2.0

description: |
  Microchip GMAC Ethernet binding

  Group G1 Ethernet driver supports following hardware peripherals:
    - module name="GMAC" id="U2005" version="1.0.0"

compatible: "microchip,gmac-g1-eth"

include:
  - name: ethernet-controller.yaml
  - name: pinctrl-device.yaml

examples:
  - |
    &gmac {
      compatible = "microchip,gmac-g1-eth";
      interrupts = <84 0>;
      interrupt-names = "gmac";
      num-queues = <1>;
    };

properties:
  reg:
    required: true

  phy-handle:
    required: true

  num-queues:
    type: int
    required: true
    description: |
      Number of hardware TX and RX queues.
      Range: 1 - 8

  phy-connection-type:
    default: "rmii"
```

## dts/bindings/flash_controller/microchip,nvmctrl-g3.yaml
```yaml
# Copyright (c) 2026 Microchip Technology Inc.
# SPDX-License-Identifier: Apache-2.0

description: Microchip flash controller

compatible: "microchip,nvmctrl-g3"

include: flash-controller.yaml

properties:
  clock-parent:
    type: phandle
    description: Reference to the clock node
```

## dts/bindings/i2s/st,stm32-sai.yaml
```yaml
# Copyright (c) 2024 ZAL Zentrum für Angewandte Luftfahrtforschung GmbH
# SPDX-License-Identifier: Apache-2.0

description: STM32 SAI controller

compatible: "st,stm32-sai"

include: [i2s-controller.yaml, pinctrl-device.yaml]

properties:
  reg:
    required: true

  dmas:
    required: true

  dma-names:
    required: true
    description: |
      DMA channel name: "tx" or "rx", depending of expected device behavior.

  pinctrl-0:
    required: true

  pinctrl-names:
    required: true

  mclk-enable:
    type: boolean
    description: |
      Master Clock Output function.
      An mck pin must be listed within pinctrl-0 when enabling this property.

  mclk-divider:
    type: string
    default: "no-div"
    description: |
      Master Clock Divider Configuration.

      When no-div property is present:
      - MCKDIV = SAI_CK_x / (FS * (FRL + 1))
      Otherwise:
      - MCKDIV = SAI_CK_x / (FS * (OSR + 1) * 256)

      When div-256 is present OSR is set to 0.
      When div-512 is present OSR is set to 1.
    enum:
      - "no-div"
      - "div-256"
      - "div-512"

  pdm-enable:
    type: boolean
    description: |
      Enable the PDM interface (SAI1/SAI4 block A on STM32H7, RX only).
      The CKx and Dx pins must be listed within pinctrl-0.

  pdm-mic-pairs:
    type: int
    default: 1
    enum: [1, 2, 3, 4]
    description: Number of PDM microphone pairs.

  pdm-clock:
    type: int
    default: 1
    enum: [1, 2]
    description: PDM bitstream clock output used (CK1 or CK2).

  synchronous:
    type: boolean
    description: |
      Synchronous mode.
      When present, the SAI controller is configured to work in synchronous mode.
```

## dts/bindings/mtd/microchip,flash-g3.yaml
```yaml
description: Microchip G3 series of Flash

compatible: "microchip,flash-g3"

include: soc-nv-flash.yaml

properties:
  write-block-size-quad-dw:
    type: int
    description: address alignment required by quad double word flash write operations
  write-block-size-row:
    type: int
    description: address alignment required by row flash write operations
  unimplemented-region:
    type: array
    description: array of unimplemented regions in the given flash area
```

## dts/bindings/usb/st,stm32-otgfs-uhc.yaml
```yaml
# SPDX-License-Identifier: Apache-2.0

description: |
  STM32 OTGFS controller used as USB host by the DWC2 UHC driver.

  Use in place of "st,stm32-otgfs", keeping "snps,dwc2" as the second compatible:

    compatible = "st,stm32-otgfs-uhc", "snps,dwc2";

compatible: "st,stm32-otgfs-uhc"

include: st,stm32-otghs-common.yaml

properties:
  pinctrl-0:
    required: true

  pinctrl-names:
    required: true
```

## dts/bindings/usb/st,stm32-otghs-uhc.yaml
```yaml
# SPDX-License-Identifier: Apache-2.0

description: |
  STM32 OTGHS controller used as USB host by the DWC2 UHC driver (embedded FS PHY).

  Use in place of "st,stm32-otghs", keeping "snps,dwc2" as the second compatible
  so that it is picked up by the UHC DWC2 driver, e.g.

    compatible = "st,stm32-otghs-uhc", "snps,dwc2";

  CONFIG_UDC_DWC2 and CONFIG_UDC_STM32 must not claim this node (UDC_DWC2=n).

compatible: "st,stm32-otghs-uhc"

include: st,stm32-otghs-common.yaml

properties:
  pinctrl-0:
    required: true

  pinctrl-names:
    required: true
```

## modules/plugandtrust/Kconfig
```kconfig
# SPDX-License-Identifier: Apache-2.0

config ZEPHYR_PLUGANDTRUST_MODULE
	bool

menuconfig PLUGANDTRUST
	bool "plugandtrust support"
	select I2C

if PLUGANDTRUST

config PLUGANDTRUST_SCP03
	bool "Enable secure channel for SE05x"
	select TINYCRYPT
	select TINYCRYPT_AES
	select TINYCRYPT_AES_CB
	select TINYCRYPT_AES_CM
	select TINYCRYPT_CTR_PR
	select TINYCRYPT_ECC_DS
	select TINYCRYPT_SHA256
	select TINYCRYPT_ECC_DH
	help
	  This option enables secure channel for SE05x.

config PLUGANDTRUST_ECKEY
	bool "Enable EC Key Authentication for SE05x"
	help
	  This option enables EC Key Authentication for SE05x.

config PLUGANDTRUST_ECKEY_SCP03
	bool "Enable eckey + scp03 for SE05x"
	help
	  This option enables eckey + scp03 for SE05x.

config PLUGANDTRUST_SM_APDU_MUTEX
	bool "Enable Mutex at APDU layer"
	help
		This option enable mutex at APDU layer.

config PLUGANDTRUST_MBEDTLS_ALT
	bool "Use ALT implementation for mbedTLS of SE05x"
	help
	  This option enables secure channel for SE05x.

config PLUGANDTRUST_APDU_BUFFER_SIZE
	int "Max APDU buffer size"
	default 255
	help
	  Max APDU buffer size.

module = PLUGANDTRUST
module-str = plugandtrust
source "subsys/logging/Kconfig.template.log_config"

endif # PLUGANDTRUST
```
