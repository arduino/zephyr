/*
 * Copyright (c) 2026 Microchip Technology Inc.
 *
 * SPDX-License-Identifier: Apache-2.0
 */

&tcc1 {
	compatible = "microchip,tcc-g1-counter";
	max-bit-width = <32>;
	prescaler = <8>;
	status = "okay";
};
